## project/deprecated/master-node/configs/project_defconfig
```kconfig
BR2_aarch64=y
BR2_cortex_a72=y
BR2_ARM_FPU_VFPV4=y
BR2_PACKAGE_HOST_LINUX_HEADERS_CUSTOM_6_6=y
BR2_GCC_VERSION_12_X=y
BR2_TOOLCHAIN_BUILDROOT_CXX=y
BR2_WGET="wget --passive-ftp -nd -t 3"
BR2_OPTIMIZE_S=y
BR2_TARGET_GENERIC_HOSTNAME="dockerclust"
BR2_TARGET_GENERIC_ISSUE="Node from Dockerclust (https://github.com/qw3rtz/dockerclust)"
BR2_INIT_OPENRC=y
BR2_TARGET_GENERIC_ROOT_PASSWD=".root1"
BR2_ROOTFS_OVERLAY="$(BR2_EXTERNAL_MASTERNODE_PATH)/rootfs-overlay"
BR2_ROOTFS_POST_BUILD_SCRIPT="$(BR2_EXTERNAL_MASTERNODE_PATH)/common/post-build.sh"
BR2_ROOTFS_POST_IMAGE_SCRIPT="$(BR2_EXTERNAL_MASTERNODE_PATH)/common/post-image.sh"
BR2_LINUX_KERNEL=y
BR2_LINUX_KERNEL_CUSTOM_TARBALL=y
BR2_LINUX_KERNEL_CUSTOM_TARBALL_LOCATION="$(call github,raspberrypi,linux,5aeecea9f4a45248bcf564dec924965e066a7bfd)/linux-5aeecea9f4a45248bcf564dec924965e066a7bfd.tar.gz"
BR2_LINUX_KERNEL_USE_CUSTOM_CONFIG=y
BR2_LINUX_KERNEL_CUSTOM_CONFIG_FILE="$(BR2_EXTERNAL_MASTERNODE_PATH)/linux-config/bcm2711_rpi-cluster"
BR2_LINUX_KERNEL_DTS_SUPPORT=y
BR2_LINUX_KERNEL_INTREE_DTS_NAME="broadcom/bcm2711-rpi-4-b"
BR2_LINUX_KERNEL_NEEDS_HOST_OPENSSL=y
BR2_PACKAGE_BUSYBOX_CONFIG="$(BR2_EXTERNAL_MASTERNODE_PATH)/busybox-config/busybox.config"
BR2_PACKAGE_ZSTD=y
BR2_PACKAGE_BTRFS_PROGS=y
BR2_PACKAGE_NFS_UTILS=y
BR2_PACKAGE_RPI_FIRMWARE=y
BR2_PACKAGE_RPI_FIRMWARE_VARIANT_PI4=y
BR2_PACKAGE_RPI_FIRMWARE_CONFIG_FILE="$(BR2_EXTERNAL_MASTERNODE_PATH)/common/config.txt"
BR2_PACKAGE_RPI_FIRMWARE_CMDLINE_FILE="$(BR2_EXTERNAL_MASTERNODE_PATH)/common/cmdline.txt"
BR2_PACKAGE_MDEVD=y
BR2_PACKAGE_CA_CERTIFICATES=y
BR2_PACKAGE_OPENSSL=y
BR2_PACKAGE_LIBAIO=y
BR2_PACKAGE_LIBNETFILTER_CONNTRACK=y
BR2_PACKAGE_LIBNETFILTER_CTHELPER=y
BR2_PACKAGE_LIBNETFILTER_CTTIMEOUT=y
BR2_PACKAGE_LIBNETFILTER_QUEUE=y
BR2_PACKAGE_LIBNFTNL=y
BR2_PACKAGE_LIBGLIB2=y
BR2_PACKAGE_NCURSES_WCHAR=y
BR2_PACKAGE_NCURSES_TARGET_PROGS=y
BR2_PACKAGE_POPT=y
BR2_PACKAGE_CHRONY=y
BR2_PACKAGE_DHCPCD=y
BR2_PACKAGE_DNSMASQ=y
BR2_PACKAGE_DROPBEAR=y
BR2_PACKAGE_IFPLUGD=y
BR2_PACKAGE_IFUPDOWN=y
BR2_PACKAGE_IPROUTE2=y
BR2_PACKAGE_TMUX=y
BR2_PACKAGE_DOCKER_CLI=y
BR2_PACKAGE_DOCKER_COMPOSE=y
BR2_PACKAGE_DOCKER_ENGINE=y
BR2_PACKAGE_VIM=y
BR2_TARGET_ROOTFS_CPIO=y
BR2_TARGET_ROOTFS_CPIO_GZIP=y
# BR2_TARGET_ROOTFS_TAR is not set
BR2_PACKAGE_HOST_DOSFSTOOLS=y
BR2_PACKAGE_HOST_E2FSPROGS=y
BR2_PACKAGE_HOST_GENIMAGE=y
BR2_PACKAGE_HOST_MTOOLS=y
BR2_PACKAGE_HOST_UBOOT_TOOLS=y
```

## project/rpi4/configs/project_defconfig
```kconfig
BR2_aarch64=y
BR2_cortex_a72=y
BR2_ARM_FPU_VFPV4=y
BR2_TOOLCHAIN_BUILDROOT_MUSL=y
BR2_PACKAGE_HOST_LINUX_HEADERS_CUSTOM_6_6=y
BR2_GCC_VERSION_12_X=y
BR2_WGET="wget --passive-ftp -nd -t 3"
BR2_OPTIMIZE_S=y
BR2_TARGET_GENERIC_HOSTNAME="dockerclust"
BR2_TARGET_GENERIC_ISSUE="Dockerclust node (https://github.com/qw3rtz/dockerclust)"
BR2_TARGET_GENERIC_ROOT_PASSWD=".dockerclust1"
BR2_ROOTFS_OVERLAY="$(BR2_EXTERNAL_DOCKERCLUST_PATH)/rootfs-overlay"
BR2_ROOTFS_POST_BUILD_SCRIPT="$(BR2_EXTERNAL_DOCKERCLUST_PATH)/common/post-build.sh"
BR2_ROOTFS_POST_IMAGE_SCRIPT="$(BR2_EXTERNAL_DOCKERCLUST_PATH)/common/post-image.sh"
BR2_LINUX_KERNEL=y
BR2_LINUX_KERNEL_CUSTOM_TARBALL=y
BR2_LINUX_KERNEL_CUSTOM_TARBALL_LOCATION="$(call github,raspberrypi,linux,576cc10e1ed50a9eacffc7a05c796051d7343ea4)/linux-576cc10e1ed50a9eacffc7a05c796051d7343ea4.tar.gz"
BR2_LINUX_KERNEL_USE_CUSTOM_CONFIG=y
BR2_LINUX_KERNEL_CUSTOM_CONFIG_FILE="$(BR2_EXTERNAL_DOCKERCLUST_PATH)/linux-config/bcm2711_linux"
BR2_LINUX_KERNEL_DTS_SUPPORT=y
BR2_LINUX_KERNEL_INTREE_DTS_NAME="broadcom/bcm2711-rpi-4-b"
BR2_LINUX_KERNEL_NEEDS_HOST_OPENSSL=y
BR2_PACKAGE_BUSYBOX_CONFIG="$(BR2_EXTERNAL_DOCKERCLUST_PATH)/busybox-config/busybox.config"
BR2_PACKAGE_BUSYBOX_SHOW_OTHERS=y
BR2_PACKAGE_ZSTD=y
BR2_PACKAGE_BTRFS_PROGS=y
BR2_PACKAGE_NFS_UTILS=y
BR2_PACKAGE_RPI_FIRMWARE=y
BR2_PACKAGE_RPI_FIRMWARE_VARIANT_PI4=y
BR2_PACKAGE_RPI_FIRMWARE_CONFIG_FILE="$(BR2_EXTERNAL_DOCKERCLUST_PATH)/common/config.txt"
BR2_PACKAGE_RPI_FIRMWARE_CMDLINE_FILE="$(BR2_EXTERNAL_DOCKERCLUST_PATH)/common/cmdline.txt"
BR2_PACKAGE_LUKSMETA=y
BR2_PACKAGE_CA_CERTIFICATES=y
BR2_PACKAGE_LIBXCRYPT=y
BR2_PACKAGE_LIBISCSI=y
BR2_PACKAGE_LIBNETFILTER_CONNTRACK=y
BR2_PACKAGE_LIBNETFILTER_CTHELPER=y
BR2_PACKAGE_LIBNETFILTER_CTTIMEOUT=y
BR2_PACKAGE_LIBNETFILTER_QUEUE=y
BR2_PACKAGE_LIBNFTNL=y
BR2_PACKAGE_LIBFFI=y
BR2_PACKAGE_PCRE2=y
BR2_PACKAGE_READLINE=y
BR2_PACKAGE_CHRONY=y
BR2_PACKAGE_DNSMASQ=y
BR2_PACKAGE_DROPBEAR=y
BR2_PACKAGE_IFPLUGD=y
BR2_PACKAGE_IFUPDOWN=y
BR2_PACKAGE_IPROUTE2=y
BR2_PACKAGE_OPEN_ISCSI=y
# BR2_PACKAGE_URANDOM_SCRIPTS is not set
BR2_PACKAGE_CONTAINERD_DRIVER_BTRFS=y
BR2_PACKAGE_DOCKER_CLI=y
BR2_PACKAGE_DOCKER_COMPOSE=y
BR2_PACKAGE_DOCKER_ENGINE=y
BR2_PACKAGE_DOCKER_ENGINE_DRIVER_BTRFS=y
BR2_PACKAGE_KMOD_TOOLS=y
BR2_TARGET_ROOTFS_CPIO=y
BR2_TARGET_ROOTFS_CPIO_XZ=y
# BR2_TARGET_ROOTFS_TAR is not set
BR2_PACKAGE_HOST_DOSFSTOOLS=y
BR2_PACKAGE_HOST_E2FSPROGS=y
BR2_PACKAGE_HOST_GENIMAGE=y
BR2_PACKAGE_HOST_KMOD_XZ=y
BR2_PACKAGE_HOST_MTOOLS=y
BR2_PACKAGE_HOST_QEMU=y
BR2_PACKAGE_HOST_UBOOT_TOOLS=y
BR2_PACKAGE_TGT=y
```

## project/rpi4/package/tgt/Config.in
```kconfig
config BR2_PACKAGE_TGT
    bool "tgt userspace SCSI target"
    default n
    help
      tgt is a user-space SCSI target framework. Useful for iSCSI, FCoE, etc.
```
